## boards/app3_1.conf
```kconfig
CONFIG_USB_DEVICE_STACK=y
CONFIG_USB_DEVICE_MANUFACTURER="Bosch Sensortec"
CONFIG_USB_DEVICE_PRODUCT="SlimeNRF Tracker BHI385"
```

## west.yml
```yaml
manifest:
  version: "1.2"
  projects:

    # nRF-Connect SDK
    - name: sdk-nrf
      path: nrf
      url: https://github.com/nrfconnect/sdk-nrf.git
      revision: v3.3.0-preview3-branch
      import: true

    # Bosch BHI385 Sensor API
    - name: bhi385_sensorapi
      path: bhi385_sensorapi
      url: https://github.com/hkn1304/bhi385_sensorapi.git
      revision: main

    # BHI385 SensorAPI (Bosch Sensortec)
    - name: bhi385_sensorapi
      path: bhi385_sensorapi
      url: https://github.com/hkn1304/bhi385_sensorapi.git
      revision: main
```
